## sdkconfig.defaults
```kconfig
# ==============================
# LOG
# ==============================
CONFIG_LOG_DEFAULT_LEVEL_INFO=y
CONFIG_LOG_COLORS=y

# ==============================
# MAIN / TASK STACK
# ==============================
CONFIG_ESP_MAIN_TASK_STACK_SIZE=8192
CONFIG_ESP_SYSTEM_EVENT_TASK_STACK_SIZE=4096

# ==============================
# MQTT
# ==============================
CONFIG_MQTT_BUFFER_SIZE=4096
CONFIG_MQTT_TASK_STACK_SIZE=6144
CONFIG_MQTT_TRANSPORT_SSL=n

# ==============================
# WIFI PERFORMANCE
# ==============================
CONFIG_ESP_WIFI_STATIC_RX_BUFFER_NUM=10
CONFIG_ESP_WIFI_DYNAMIC_RX_BUFFER_NUM=32
CONFIG_ESP_WIFI_DYNAMIC_TX_BUFFER_NUM=32

CONFIG_ESP_WIFI_RX_BA_WIN=6
CONFIG_ESP_WIFI_TX_BA_WIN=6

# ==============================
# LWIP / NETWORK STABILITY
# ==============================
CONFIG_LWIP_TCP_KEEPALIVE=y
CONFIG_LWIP_TCP_KEEPIDLE_DEFAULT=5000
CONFIG_LWIP_TCP_KEEPINTVL_DEFAULT=5000
CONFIG_LWIP_TCP_KEEPCNT_DEFAULT=3

CONFIG_LWIP_MAX_SOCKETS=10

# ==============================
# FREERTOS
# ==============================
CONFIG_FREERTOS_HZ=1000
CONFIG_FREERTOS_TIMER_TASK_STACK_DEPTH=4096

# ==============================
# WATCHDOG
# ==============================
CONFIG_ESP_TASK_WDT_TIMEOUT_S=10

# ==============================
# MEMORY
# ==============================
CONFIG_SPIRAM_SUPPORT=n
CONFIG_HEAP_POISONING_DISABLED=y

# ==============================
# OPTIMIZATION
# ==============================
CONFIG_COMPILER_OPTIMIZATION_SIZE=y
```
